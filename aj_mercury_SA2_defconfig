## aj_mercury_SA2_defconfig
```kconfig
BR2_arm=y
BR2_cortex_a9=y
BR2_ARM_ENABLE_NEON=y
BR2_ARM_ENABLE_VFP=y
BR2_ARM_FPU_NEON=y
BR2_WGET="wget --passive-ftp -nd -t 3 --no-check-certificate"
BR2_TOOLCHAIN_EXTERNAL=y
BR2_TOOLCHAIN_EXTERNAL_LINARO_ARM=y
BR2_TOOLCHAIN_EXTERNAL_GDB_SERVER_COPY=y
BR2_ECLIPSE_REGISTER=y
BR2_TARGET_GENERIC_HOSTNAME="ICP"
BR2_TARGET_GENERIC_ISSUE="ICP system on eMMC"
BR2_INIT_SYSV=y
BR2_ROOTFS_DEVICE_CREATION_DYNAMIC_MDEV=y
# BR2_TARGET_ENABLE_ROOT_LOGIN is not set
BR2_ENABLE_LOCALE_WHITELIST="C en_US de fr"
BR2_ROOTFS_USERS_TABLES="~/Projekte/ICP/Linux/MMC/users/users.conf"
BR2_ROOTFS_POST_BUILD_SCRIPT="~/Projekte/ICP/Linux/scripte/icp_custom_rootfs_/icp_custom_rootfs.sh"
BR2_ROOTFS_POST_IMAGE_SCRIPT="~/Projekte/ICP/Linux/scripte/icp_update_files_/icp_update_files.sh"
BR2_ROOTFS_POST_SCRIPT_ARGS="MMC flash_mmc_V1.00.00.00 uboot_env altera-linux_ buildroot_mm start_scripte_ www_ scripte altera-uboot_ image_oes"
BR2_PACKAGE_UNZIP=y
BR2_PACKAGE_ZIP=y
BR2_PACKAGE_AUTOFS=y
BR2_PACKAGE_E2FSPROGS=y
BR2_PACKAGE_MMC_UTILS=y
BR2_PACKAGE_MTD=y
BR2_PACKAGE_UBOOT_TOOLS=y
BR2_PACKAGE_PHP=y
BR2_PACKAGE_LIBARCHIVE=y
BR2_PACKAGE_LIBARCHIVE_BSDTAR=y
BR2_PACKAGE_LIBARCHIVE_BSDCPIO=y
BR2_PACKAGE_LIBARCHIVE_BSDCAT=y
BR2_PACKAGE_LIBZIP=y
BR2_PACKAGE_LIBLOGGING=y
BR2_PACKAGE_DHCP=y
BR2_PACKAGE_DHCP_SERVER=y
BR2_PACKAGE_DHCPCD=y
BR2_PACKAGE_DROPBEAR=y
BR2_PACKAGE_ETHTOOL=y
# BR2_PACKAGE_ETHTOOL_PRETTY_PRINT is not set
BR2_PACKAGE_IFUPDOWN=y
BR2_PACKAGE_IPUTILS=y
BR2_PACKAGE_LIGHTTPD=y
BR2_PACKAGE_LIGHTTPD_OPENSSL=y
BR2_PACKAGE_LIGHTTPD_PCRE=y
BR2_PACKAGE_NET_TOOLS=y
BR2_PACKAGE_NTP=y
BR2_PACKAGE_NTP_NTPDATE=y
BR2_PACKAGE_OPENSSH=y
BR2_PACKAGE_BASH=y
BR2_PACKAGE_LOGROTATE=y
BR2_PACKAGE_DCRON=y
BR2_PACKAGE_MONIT=y
BR2_PACKAGE_PROCPS_NG=y
BR2_PACKAGE_START_STOP_DAEMON=y
BR2_PACKAGE_SWUPDATE=y
BR2_PACKAGE_SYSLOG_NG=y
BR2_PACKAGE_NANO=y
BR2_TARGET_ROOTFS_EXT2=y
BR2_TARGET_ROOTFS_EXT2_3=y
```
